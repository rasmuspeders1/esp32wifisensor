## main/Kconfig.projbuild
```kconfig
menu "Application Configuration"

config WIFI_SSID
    string "WiFi SSID"
    default "myssid"
    help
	SSID (network name) for the example to connect to.

config WIFI_PASSWORD
    string "WiFi Password"
    default "mypassword"
    help
	WiFi password (WPA or WPA2) for the example to use.

config LOCATION_TAG
    string "Location Tag"
    default ""
    help
	Location Tag to tag measurement data with. E.g. "living room".
endmenu
```
